## drivers/ocmp/Kconfig
```kconfig
# oytput compare configuration options

# Copyright (c) 2020 Marek Porwisz
# SPDX-License-Identifier: Apache-2.0

menuconfig OUTPUT_CMP
	bool "Timer output compare api"
	help
	  Enable support for timers outpyt compare.

if OUTPUT_CMP

module = OUTPUT_CMP
module-str = timer_oc
source "drivers/ocmp/Kconfig.oc_stm32"
source "subsys/logging/Kconfig.template.log_config"

endif # OUTPUT_CMP
```

## drivers/ocmp/Kconfig.oc_stm32
```kconfig
# STM32 Output compare

# Copyright (c) 2020, Marek Porwisz
# SPDX-License-Identifier: Apache-2.0

menuconfig OC_STM32
	bool "STM32 output compare driver"
	depends on SOC_FAMILY_STM32
	select USE_STM32_HAL_TIM
	help
	  Build timers output compare driver for STM32 SoCs. Tested on STM32 F1 series.
```

## dts/bindings/oc/oc-controller.yaml
```yaml
# Copyright (c) 2020, Marek Porwisz
# SPDX-License-Identifier: Apache-2.0

# Common fields for OC controllers

properties:
    label:
      required: true

    "#oc-cells":
      type: int
      required: true
      description: Number of items to expect in a oc specifier
```

## dts/bindings/oc/st,stm32-oc.yaml
```yaml
description: STM32 OUTPUT CMP

compatible: "st,stm32-oc"

include: [oc-controller.yaml, base.yaml]

properties:
    label:
      required: true

    timer:
      type: phandle
      required: true 

    st,prescaler:
      type: int
      required: true
      description: Clock prescaler at the input of the timer
```
